/* source keypos definitions */
#include "../zmk-nodefree-config/keypos_def/keypos_34keys.h"

/* activate bluetooth */
#define CONFIG_WIRELESS 1

/* source the main keymap */
#include "cradio_base.keymap"